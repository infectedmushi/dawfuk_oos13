## oplus/kernel/charger/v1/Kconfig
```kconfig
config MTK_DISABLE_GAUGE
	bool "OPLUS MTK disable gauge "
	help
	  Say Y here to include support

config OPLUS_SMOOTH_SOC
	bool "OPLUS config smooth soc "
	help
	  Say Y here to include smooth soc

config OPLUS_SHORT_USERSPACE
	bool "OPLUS batt userspace"
	help
	  Say Y to include support

config OPLUS_CHIP_SOC_NODE
	bool "OPLUS chip soc node"
	help
	  Say Y to include support

config OPLUS_CHARGER_WIRELESS_PEN
        bool "OPLUS charger wireless pen"
        help
          Say Y to include support

config OPLUS_CHARGER_OPTIGA
	bool "OPLUS OPTIGA soc node"
	help
	  Say Y to include support

config OPLUS_MTK_DRM_GKI_NOTIFY_CHG
	default n
	tristate "chg mtk gki notify"

config OPLUS_SM8450_CHARGER
	bool "OPLUS SM8450 charger driver"
	help
	  Enables support for the sm8450 charging
```
